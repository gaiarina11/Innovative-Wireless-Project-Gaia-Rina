## prj.conf
```kconfig
#
# Copyright (c) 2024 Nordic Semiconductor ASA
#
# SPDX-License-Identifier: LicenseRef-Nordic-5-Clause
#

CONFIG_NCS_SAMPLES_DEFAULTS=y
CONFIG_DK_LIBRARY=y

CONFIG_BT=y
CONFIG_BT_SMP=y
CONFIG_BT_CENTRAL=y
CONFIG_BT_MAX_CONN=3
CONFIG_BT_BONDABLE=y

CONFIG_BT_GATT_CLIENT=y
CONFIG_BT_GATT_DYNAMIC_DB=y

CONFIG_BT_CHANNEL_SOUNDING=y
CONFIG_BT_RAS=y
CONFIG_BT_RAS_RREQ=y

CONFIG_BT_SCAN=y
CONFIG_BT_SCAN_FILTER_ENABLE=y
CONFIG_BT_SCAN_UUID_CNT=1

# The Ranging Profile recommends a MTU of at least 247 octets.
CONFIG_BT_L2CAP_TX_MTU=498
CONFIG_BT_BUF_ACL_TX_SIZE=502
CONFIG_BT_BUF_ACL_RX_SIZE=502
CONFIG_BT_ATT_PREPARE_COUNT=3
CONFIG_BT_CTLR_DATA_LENGTH_MAX=251

# This allows CS and ACL to use different PHYs
CONFIG_BT_TRANSMIT_POWER_CONTROL=y

# This improves the performance of floating-point operations
CONFIG_FPU=y
CONFIG_FPU_SHARING=y

CONFIG_CBPRINTF_FP_SUPPORT=y

CONFIG_BT_LOG_LEVEL_INF=y
CONFIG_LOG=y
CONFIG_BT_HCI_CORE_LOG_LEVEL_INF=y

CONFIG_BT_MAX_PAIRED=3

# Aumento dei buffer per gestire 3 connessioni simultanee (Risolve err -12)
CONFIG_BT_BUF_ACL_TX_COUNT=10
CONFIG_BT_BUF_ACL_RX_COUNT=10
CONFIG_BT_L2CAP_TX_BUF_COUNT=10

CONFIG_BT_LL_SW_SPLIT=n
CONFIG_BT_CTLR_SDC_CS_MAX_ANTENNA_PATHS=2
CONFIG_BT_CTLR_SDC_CS_COUNT=3

CONFIG_BT_FILTER_ACCEPT_LIST=y
```

## src/main.c
```c
/* Copyright (c) 2024 Nordic Semiconductor ASA
 *
 * SPDX-License-Identifier: LicenseRef-Nordic-5-Clause
 */

/** @file
 * @brief Channel Sounding Initiator with Ranging Requestor sample
 * Multi-connection (3 reflector) + trilateration
 */

 #include <zephyr/kernel.h>
 #include <zephyr/types.h>
 #include <zephyr/bluetooth/cs.h>
 #include <zephyr/bluetooth/gatt.h>
 #include <zephyr/bluetooth/conn.h>
 #include <bluetooth/scan.h>
 #include <bluetooth/services/ras.h>
 #include <bluetooth/gatt_dm.h>
 #include "distance_estimation.h"
 #include <dk_buttons_and_leds.h>
 #include <zephyr/logging/log.h>
 LOG_MODULE_REGISTER(app_main, LOG_LEVEL_INF);
 #define CON_STATUS_LED DK_LED1
 #define CS_CONFIG_ID 0
 #define NUM_MODE_0_STEPS 3
 #define PROCEDURE_COUNTER_NONE (-1)
 #define LOCAL_PROCEDURE_MEM                                                     \
 ((BT_RAS_MAX_STEPS_PER_PROCEDURE * sizeof(struct bt_le_cs_subevent_step)) + \
 (BT_RAS_MAX_STEPS_PER_PROCEDURE * BT_RAS_MAX_STEP_DATA_LEN))
 /* Semafori globali per la fase di configurazione sequenziale */
 static K_SEM_DEFINE(sem_remote_capabilities_obtained, 0, 1);
 static K_SEM_DEFINE(sem_config_created, 0, 1);
 static K_SEM_DEFINE(sem_cs_security_enabled, 0, 1);
 static K_SEM_DEFINE(sem_connected, 0, 1);
 static K_SEM_DEFINE(sem_discovery_done, 0, 1);
 static K_SEM_DEFINE(sem_mtu_exchange_done, 0, 1);
 static K_SEM_DEFINE(sem_security, 0, 1);
 /* Gestione Multiconnessione (3 Reflector) */
 #define MAX_REFLECTORS 3
 static struct bt_conn *connections[MAX_REFLECTORS] = {NULL};
 static uint8_t connected_count = 0;
 /* Capabilities salvate per ogni reflector */
 static struct bt_conn_le_cs_capabilities remote_caps[MAX_REFLECTORS];
 
 static K_SEM_DEFINE(sem_disconnected, 0, 1);
 static uint8_t target_reflector_idx = 0; /* Traccia quale reflector stiamo gestendo */
 
 /* Buffer separati per ogni reflector */
 NET_BUF_SIMPLE_DEFINE_STATIC(local_steps_0, LOCAL_PROCEDURE_MEM);
 NET_BUF_SIMPLE_DEFINE_STATIC(peer_steps_0, BT_RAS_PROCEDURE_MEM);
 NET_BUF_SIMPLE_DEFINE_STATIC(local_steps_1, LOCAL_PROCEDURE_MEM);
 NET_BUF_SIMPLE_DEFINE_STATIC(peer_steps_1, BT_RAS_PROCEDURE_MEM);
 NET_BUF_SIMPLE_DEFINE_STATIC(local_steps_2, LOCAL_PROCEDURE_MEM);
 NET_BUF_SIMPLE_DEFINE_STATIC(peer_steps_2, BT_RAS_PROCEDURE_MEM);
 static struct net_buf_simple *local_steps_ptrs[MAX_REFLECTORS] = {
 &local_steps_0, &local_steps_1, &local_steps_2};
 static struct net_buf_simple *peer_steps_ptrs[MAX_REFLECTORS] = {
 &peer_steps_0, &peer_steps_1, &peer_steps_2};
 /* Variabili di stato per ogni reflector */
 static int32_t most_recent_peer_ranging_counter[MAX_REFLECTORS] = {
 PROCEDURE_COUNTER_NONE, PROCEDURE_COUNTER_NONE, PROCEDURE_COUNTER_NONE};
 static int32_t most_recent_local_ranging_counter[MAX_REFLECTORS] = {
 PROCEDURE_COUNTER_NONE, PROCEDURE_COUNTER_NONE, PROCEDURE_COUNTER_NONE};
 static int32_t dropped_ranging_counter[MAX_REFLECTORS] = {
 PROCEDURE_COUNTER_NONE, PROCEDURE_COUNTER_NONE, PROCEDURE_COUNTER_NONE};
 static bool distance_estimation_in_progress[MAX_REFLECTORS] = {false, false, false};
 static uint8_t n_ap_arr[MAX_REFLECTORS];
 /* Semafori di ranging per ogni connessione */
 static struct k_sem sem_procedure_done_arr[MAX_REFLECTORS];
 static struct k_sem sem_rd_ready_arr[MAX_REFLECTORS];
 static struct k_sem sem_rd_complete_arr[MAX_REFLECTORS];
 static int get_reflector_index(struct bt_conn *conn)
 {
 for (int i = 0; i < MAX_REFLECTORS; i++)
 {
 if (connections[i] == conn)
 {
 return i;
 }
 }
 return -1;
 }
 /* ── Callbacks CS ─────────────────────────────────────────────────────────── */
 static void subevent_result_cb(struct bt_conn *conn,
   struct bt_conn_le_cs_subevent_result *result)
 {
 int idx = get_reflector_index(conn);
 if (idx < 0)
 return;
 
 LOG_INF("[R%d] Subevent result %d", idx, result->header.procedure_counter);
 
 struct net_buf_simple *local_steps = local_steps_ptrs[idx];
 
 if (distance_estimation_in_progress[idx])
 {
 LOG_WRN("[R%d] Estimation in progress, dropping procedure.", idx);
 dropped_ranging_counter[idx] = result->header.procedure_counter;
 return;
 }
 
 /* FIX 1: Non eseguire il return se il subevent fallisce! */
 if (result->header.subevent_done_status == BT_CONN_LE_CS_SUBEVENT_ABORTED)
 {
 LOG_WRN("[R%d] Subevent aborted", idx);
 dropped_ranging_counter[idx] = result->header.procedure_counter;
 net_buf_simple_reset(local_steps);
 }
 else
 {
 /* Se non è abortito, estrai i dati nei buffer */
 if (dropped_ranging_counter[idx] != result->header.procedure_counter)
 {
 if (result->step_data_buf)
 {
 if (result->step_data_buf->len <= net_buf_simple_tailroom(local_steps))
 {
 uint16_t len = result->step_data_buf->len;
 uint8_t *step_data = net_buf_simple_pull_mem(
 result->step_data_buf, len);
 net_buf_simple_add_mem(local_steps, step_data, len);
 }
 else
 {
 LOG_ERR("[R%d] Not enough memory for step data.", idx);
 net_buf_simple_reset(local_steps);
 dropped_ranging_counter[idx] = result->header.procedure_counter;
 }
 }
 }
 }
 
 /* FIX 2: Controlla sempre lo stato di fine procedura per sbloccare il semaforo */
 if (result->header.procedure_done_status == BT_CONN_LE_CS_PROCEDURE_COMPLETE)
 {
 dropped_ranging_counter[idx] = PROCEDURE_COUNTER_NONE;
 n_ap_arr[idx] = result->header.num_antenna_paths;
 most_recent_local_ranging_counter[idx] = result->header.procedure_counter;
 distance_estimation_in_progress[idx] = true;
 k_sem_give(&sem_procedure_done_arr[idx]);
 }
 else if (result->header.procedure_done_status == BT_CONN_LE_CS_PROCEDURE_ABORTED)
 {
 LOG_WRN("[R%d] Procedure aborted", idx);
 net_buf_simple_reset(local_steps);
 dropped_ranging_counter[idx] = PROCEDURE_COUNTER_NONE;
 distance_estimation_in_progress[idx] = false; /* Segnala al main il fallimento */
 k_sem_give(&sem_procedure_done_arr[idx]);  /* SBLOCCA IL MAIN! */
 }
 }
 static void ranging_data_get_complete_cb(struct bt_conn *conn,
 uint16_t ranging_counter, int err)
 {
 int idx = get_reflector_index(conn);
 if (idx < 0)
 return;
 if (err)
 {
 LOG_ERR("[R%d] Error getting ranging data (err %d)", idx, err);
 return;
 }
 LOG_INF("[R%d] Ranging data complete, counter %d", idx, ranging_counter);
 k_sem_give(&sem_rd_complete_arr[idx]);
 }
 static void ranging_data_ready_cb(struct bt_conn *conn, uint16_t ranging_counter)
 {
 int idx = get_reflector_index(conn);
 if (idx < 0)
 return;
 LOG_INF("[R%d] Ranging data ready %d", idx, ranging_counter);
 most_recent_peer_ranging_counter[idx] = ranging_counter;
 k_sem_give(&sem_rd_ready_arr[idx]);
 }
 static void ranging_data_overwritten_cb(struct bt_conn *conn, uint16_t ranging_counter)
 {
 int idx = get_reflector_index(conn);
 if (idx < 0)
 return;
 LOG_INF("[R%d] Ranging data overwritten %d", idx, ranging_counter);
 }
 static void mtu_exchange_cb(struct bt_conn *conn, uint8_t err,
 struct bt_gatt_exchange_params *params)
 {
 if (err)
 {
 LOG_ERR("MTU exchange failed (err %d)", err);
 return;
 }
 LOG_INF("MTU exchange success (%u)", bt_gatt_get_mtu(conn));
 k_sem_give(&sem_mtu_exchange_done);
 }
 static void discovery_completed_cb(struct bt_gatt_dm *dm, void *context)
 {
 int err;
 LOG_INF("Discovery succeeded");
 struct bt_conn *conn = bt_gatt_dm_conn_get(dm);
 bt_gatt_dm_data_print(dm);
 err = bt_ras_rreq_alloc_and_assign_handles(dm, conn);
 if (err)
 {
 LOG_ERR("RAS RREQ alloc failed (err %d)", err);
 }
 err = bt_gatt_dm_data_release(dm);
 if (err)
 {
 LOG_ERR("Discovery data release failed (err %d)", err);
 }
 k_sem_give(&sem_discovery_done);
 }
 static void discovery_service_not_found_cb(struct bt_conn *conn, void *context)
 {
 LOG_INF("Service not found, disconnecting");
 bt_conn_disconnect(conn, BT_HCI_ERR_REMOTE_USER_TERM_CONN);
 }
 static void discovery_error_found_cb(struct bt_conn *conn, int err, void *context)
 {
 LOG_INF("Discovery error (err %d)", err);
 bt_conn_disconnect(conn, BT_HCI_ERR_REMOTE_USER_TERM_CONN);
 }
 static struct bt_gatt_dm_cb discovery_cb = {
 .completed = discovery_completed_cb,
 .service_not_found = discovery_service_not_found_cb,
 .error_found = discovery_error_found_cb,
 };
 static void security_changed(struct bt_conn *conn, bt_security_t level,
 enum bt_security_err err)
 {
 char addr[BT_ADDR_LE_STR_LEN];
 bt_addr_le_to_str(bt_conn_get_dst(conn), addr, sizeof(addr));
 if (err)
 {
 LOG_ERR("Security failed: %s level %u err %d %s",
 addr, level, err, bt_security_err_to_str(err));
 return;
 }
 LOG_INF("Security changed: %s level %u", addr, level);
 k_sem_give(&sem_security);
 }
 static bool le_param_req(struct bt_conn *conn, struct bt_le_conn_param *param)
 {
 return false;
 }
 static void connected_cb(struct bt_conn *conn, uint8_t err)
 {
 char addr[BT_ADDR_LE_STR_LEN];
 (void)bt_addr_le_to_str(bt_conn_get_dst(conn), addr, sizeof(addr));
 LOG_INF("Connected to %s (err 0x%02X)", addr, err);
 
 if (err)
 {
 bt_conn_unref(conn);
 return;
 }
 
 /* Salva la connessione direttamente nella cella del reflector attivo */
 connections[target_reflector_idx] = bt_conn_ref(conn);
 k_sem_give(&sem_connected);
 dk_set_led_on(CON_STATUS_LED);
 }
 
 static void disconnected_cb(struct bt_conn *conn, uint8_t reason)
 {
 LOG_INF("Disconnected (reason 0x%02X)", reason);
 if (connections[target_reflector_idx] == conn)
 {
 bt_conn_unref(conn);
 connections[target_reflector_idx] = NULL;
 }
 dk_set_led_off(CON_STATUS_LED);
 k_sem_give(&sem_disconnected); /* Sblocca il main dopo la disconnessione */
 }
 
 static void remote_capabilities_cb(struct bt_conn *conn,
   struct bt_conn_le_cs_capabilities *params)
 {
 int idx = get_reflector_index(conn);
 if (idx >= 0 && params)
 {
 remote_caps[idx] = *params;
 LOG_INF("[R%d] Capabilities: antennas=%d snr=%d cs_sync_2m=%d",
 idx,
 params->num_antennas_supported,
 params->tx_snr_capability,
 params->cs_sync_2m_phy_supported);
 }
 LOG_INF("CS capability exchange completed.");
 k_sem_give(&sem_remote_capabilities_obtained);
 }
 static void config_created_cb(struct bt_conn *conn, struct bt_conn_le_cs_config *config)
 {
 LOG_INF("CS config created. ID: %d", config->id);
 k_sem_give(&sem_config_created);
 }
 static void security_enabled_cb(struct bt_conn *conn)
 {
 LOG_INF("CS security enabled.");
 k_sem_give(&sem_cs_security_enabled);
 }
 static void procedure_enabled_cb(struct bt_conn *conn,
 struct bt_conn_le_cs_procedure_enable_complete *params)
 {
 LOG_INF("CS procedures %s.", params->state == 1 ? "enabled" : "disabled");
 }
 /* ── Scan ─────────────────────────────────────────────────────────────────── */
 static void scan_filter_match(struct bt_scan_device_info *device_info,
  struct bt_scan_filter_match *filter_match,
  bool connectable)
 {
 char addr[BT_ADDR_LE_STR_LEN];
 bt_addr_le_to_str(device_info->recv_info->addr, addr, sizeof(addr));
 LOG_INF("Filter matched: %s connectable: %d", addr, connectable);
 }
 static void scan_connecting_error(struct bt_scan_device_info *device_info)
 {
 int err;
 LOG_INF("Connecting failed, restarting scan");
 err = bt_scan_start(BT_SCAN_TYPE_SCAN_PASSIVE);
 if (err)
 {
 LOG_ERR("Failed to restart scan (err %i)", err);
 }
 }
 static void scan_connecting(struct bt_scan_device_info *device_info,
 struct bt_conn *conn)
 {
 LOG_INF("Connecting...");
 }
 BT_SCAN_CB_INIT(scan_cb, scan_filter_match, NULL,
 scan_connecting_error, scan_connecting);
 static int scan_init(void)
 {
 int err;
 struct bt_scan_init_param param = {
 .scan_param = NULL,
 .conn_param = BT_LE_CONN_PARAM(40, 40, 0, 400), /* 200 ms */
 .connect_if_match = 1};
 bt_scan_init(&param);
 bt_scan_cb_register(&scan_cb);
 err = bt_scan_filter_add(BT_SCAN_FILTER_TYPE_UUID, BT_UUID_RANGING_SERVICE);
 if (err)
 {
 LOG_ERR("Cannot set scan filter (err %d)", err);
 return err;
 }
 err = bt_scan_filter_enable(BT_SCAN_UUID_FILTER, false);
 if (err)
 {
 LOG_ERR("Cannot enable filter (err %d)", err);
 return err;
 }
 return 0;
 }
 BT_CONN_CB_DEFINE(conn_cb) = {
 .connected = connected_cb,
 .disconnected = disconnected_cb,
 .le_param_req = le_param_req,
 .security_changed = security_changed,
 .le_cs_remote_capabilities_available = remote_capabilities_cb,
 .le_cs_config_created = config_created_cb,
 .le_cs_security_enabled = security_enabled_cb,
 .le_cs_procedure_enabled = procedure_enabled_cb,
 .le_cs_subevent_data_available = subevent_result_cb,
 };
 /* ── main ─────────────────────────────────────────────────────────────────── */
 int main(void)
 {
 int err;
 
 LOG_INF("CS Initiator — Multi-Connection Pure Sequential");
 
 dk_leds_init();
 
 err = bt_enable(NULL);
 if (err)
 {
 LOG_ERR("Bluetooth init failed (err %d)", err);
 return 0;
 }
 
 bt_unpair(BT_ID_DEFAULT, BT_ADDR_LE_ANY);
 printk("\n[RESET] Vecchi accoppiamenti cancellati.\n\n");
 
 err = scan_init();
 if (err)
 {
 LOG_ERR("Scan init failed (err %d)", err);
 return 0;
 }
 
 memset(remote_caps, 0, sizeof(remote_caps));
 
 for (int i = 0; i < MAX_REFLECTORS; i++)
 {
 k_sem_init(&sem_procedure_done_arr[i], 0, 1);
 k_sem_init(&sem_rd_ready_arr[i], 0, 1);
 k_sem_init(&sem_rd_complete_arr[i], 0, 1);
 }
 
 /* Ciclo infinito Sequenziale Puro */
 while (true)
 {
 
 for (int i = 0; i < MAX_REFLECTORS; i++)
 {
 target_reflector_idx = i; /* Imposta l'indice per le callback */
 
 LOG_INF("====== [R%d] Fase 1: Avvio scansione e Connessione ======", i);
 
 err = bt_scan_start(BT_SCAN_TYPE_SCAN_PASSIVE);
 if (err)
 {
 LOG_ERR("Scan start failed (err %i)", err);
 k_sleep(K_MSEC(1000));
 continue;
 }
 
 k_sem_take(&sem_connected, K_FOREVER);
 bt_scan_stop();
 
 struct bt_conn *current_conn = connections[i];
 if (!current_conn)
 {
 continue;
 }
 
 LOG_INF("====== [R%d] Fase 2: Configurazione Servizi e Parametri ======", i);
 
 err = bt_conn_set_security(current_conn, BT_SECURITY_L2);
 if (err)
 {
 LOG_ERR("Security failed");
 goto cleanup_conn;
 }
 k_sem_take(&sem_security, K_FOREVER);
 
 static struct bt_gatt_exchange_params mtu_params;
 mtu_params.func = mtu_exchange_cb;
 bt_gatt_exchange_mtu(current_conn, &mtu_params);
 k_sem_take(&sem_mtu_exchange_done, K_FOREVER);
 
 err = bt_gatt_dm_start(current_conn, BT_UUID_RANGING_SERVICE, &discovery_cb, NULL);
 if (err)
 {
 LOG_ERR("Discovery failed");
 goto cleanup_conn;
 }
 k_sem_take(&sem_discovery_done, K_FOREVER);
 
 const struct bt_le_cs_set_default_settings_param default_settings = {
 .enable_initiator_role = true,
 .enable_reflector_role = false,
 .cs_sync_antenna_selection = BT_LE_CS_ANTENNA_SELECTION_OPT_REPETITIVE,
 .max_tx_power = BT_HCI_OP_LE_CS_MAX_MAX_TX_POWER,
 };
 bt_le_cs_set_default_settings(current_conn, &default_settings);
 
 bt_ras_rreq_rd_overwritten_subscribe(current_conn, ranging_data_overwritten_cb);
 bt_ras_rreq_rd_ready_subscribe(current_conn, ranging_data_ready_cb);
 bt_ras_rreq_on_demand_rd_subscribe(current_conn);
 bt_ras_rreq_cp_subscribe(current_conn);
 
 err = bt_le_cs_read_remote_supported_capabilities(current_conn);
 k_sem_take(&sem_remote_capabilities_obtained, K_FOREVER);
 
 struct bt_le_cs_create_config_params config_params = {
 .id = CS_CONFIG_ID,
 .main_mode_type = BT_CONN_LE_CS_MAIN_MODE_2,
 .sub_mode_type = BT_CONN_LE_CS_SUB_MODE_UNUSED,
 .min_main_mode_steps = 10,
 .max_main_mode_steps = 20,
 .mode_0_steps = NUM_MODE_0_STEPS,
 .role = BT_CONN_LE_CS_ROLE_INITIATOR,
 .rtt_type = BT_CONN_LE_CS_RTT_TYPE_AA_ONLY,
 .cs_sync_phy = BT_CONN_LE_CS_SYNC_1M_PHY,
 .channel_map_repetition = 5,
 .channel_selection_type = BT_CONN_LE_CS_CHSEL_TYPE_3B,
 .ch3c_shape = BT_CONN_LE_CS_CH3C_SHAPE_HAT,
 .ch3c_jump = 2,
 };
 bt_le_cs_set_valid_chmap_bits(config_params.channel_map);
 
 err = bt_le_cs_create_config(current_conn, &config_params, BT_LE_CS_CREATE_CONFIG_CONTEXT_LOCAL_AND_REMOTE);
 k_sem_take(&sem_config_created, K_FOREVER);
 
 err = bt_le_cs_security_enable(current_conn);
 k_sem_take(&sem_cs_security_enabled, K_FOREVER);
 
 uint8_t antenna_cfg = (remote_caps[i].num_antennas_supported >= 2) ? BT_LE_CS_TONE_ANTENNA_CONFIGURATION_INDEX_ONE : 0;
 uint8_t proc_phy = remote_caps[i].cs_sync_2m_phy_supported ? (uint8_t)BT_LE_CS_PROCEDURE_PHY_2M : (uint8_t)BT_LE_CS_PROCEDURE_PHY_1M;
 
 const struct bt_le_cs_set_procedure_parameters_param procedure_params = {
 .config_id = CS_CONFIG_ID,
 .max_procedure_len = 12,
 .min_procedure_interval = 16,
 .max_procedure_interval = 160,
 .max_procedure_count = 1, /* Esegui una sola misura */
 .min_subevent_len = 5000,
 .max_subevent_len = 5000,
 .tone_antenna_config_selection = antenna_cfg,
 .phy = proc_phy,
 .tx_power_delta = 0x80,
 .preferred_peer_antenna = BT_LE_CS_PROCEDURE_PREFERRED_PEER_ANTENNA_1,
 .snr_control_initiator = 0xFF,
 .snr_control_reflector = 0xFF,
 };
 bt_le_cs_set_procedure_parameters(current_conn, &procedure_params);
 
 LOG_INF("====== [R%d] Fase 3: Avvio Ranging ed Estrazione Dati ======", i);
 
 struct bt_le_cs_procedure_enable_param enable_params = {
 .config_id = CS_CONFIG_ID,
 .enable = 1,
 };
 
 err = bt_le_cs_procedure_enable(current_conn, &enable_params);
 if (err)
 {
 goto cleanup_conn;
 }
 
 err = k_sem_take(&sem_procedure_done_arr[i], K_SECONDS(2));
 if (err != 0 || !distance_estimation_in_progress[i])
 {
 goto reset_buffers;
 }
 
 err = k_sem_take(&sem_rd_ready_arr[i], K_SECONDS(1));
 if (err)
 {
 goto reset_buffers;
 }
 
 if (most_recent_peer_ranging_counter[i] != most_recent_local_ranging_counter[i])
 {
 goto reset_buffers;
 }
 
 err = bt_ras_rreq_cp_get_ranging_data(current_conn, peer_steps_ptrs[i], most_recent_peer_ranging_counter[i], ranging_data_get_complete_cb);
 if (err)
 {
 goto reset_buffers;
 }
 
 err = k_sem_take(&sem_rd_complete_arr[i], K_SECONDS(3));
 if (err)
 {
 goto reset_buffers;
 }
 
 /* Elaborazione e stampa */
 {
 char addr_str[BT_ADDR_LE_STR_LEN];
 bt_addr_le_to_str(bt_conn_get_dst(current_conn), addr_str, sizeof(addr_str));
 printk("CS_DATA:REFLECTOR_ID:%d|MAC:%s\n", i, addr_str);
 estimate_distance(local_steps_ptrs[i], peer_steps_ptrs[i], n_ap_arr[i], BT_CONN_LE_CS_ROLE_INITIATOR);
 }
 
 reset_buffers:
 net_buf_simple_reset(local_steps_ptrs[i]);
 net_buf_simple_reset(peer_steps_ptrs[i]);
 distance_estimation_in_progress[i] = false;
 
 cleanup_conn:
 LOG_INF("====== [R%d] Fase 4: Disconnessione Forzata Radio ======", i);
 if (connections[i])
 {
 err = bt_conn_disconnect(connections[i], BT_HCI_ERR_REMOTE_USER_TERM_CONN);
 if (!err)
 {
 k_sem_take(&sem_disconnected, K_FOREVER); /* Aspetta la rimozione reale della connessione */
 }
 }
 
 /* Piccola pausa prima di scansionare il prossimo reflector */
 k_sleep(K_MSEC(100));
 
 } /* Fine ciclo for dei 3 reflector */
 } /* Fine del while(true) */
 
 return 0;
 }
```

## src/distance_estimation.c
```c
/*
 * Copyright (c) 2024 Nordic Semiconductor ASA
 *
 * SPDX-License-Identifier: LicenseRef-Nordic-5-Clause
 */

/** @file
 *  @brief Channel Sounding distance estimation for Ranging Requestor
 */

#include "zephyr/bluetooth/hci_types.h"
#include <math.h>
#include <zephyr/bluetooth/cs.h>
#include <bluetooth/services/ras.h>

#include <zephyr/logging/log.h>
LOG_MODULE_DECLARE(app_main, LOG_LEVEL_INF);

#define CS_FREQUENCY_MHZ(ch)	(2402u + 1u * (ch))
#define CS_FREQUENCY_HZ(ch)	(CS_FREQUENCY_MHZ(ch) * 1000000.0f)
#define SPEED_OF_LIGHT_M_PER_S	(299792458.0f)
#define SPEED_OF_LIGHT_NM_PER_S (SPEED_OF_LIGHT_M_PER_S / 1000000000.0f)
#define PI			3.14159265358979323846f
#define MAX_NUM_RTT_SAMPLES		256
#define MAX_NUM_IQ_SAMPLES		256 * CONFIG_BT_RAS_MAX_ANTENNA_PATHS

struct iq_sample_and_channel {
	bool failed;
	uint8_t channel;
	uint8_t antenna_permutation;
	struct bt_le_cs_iq_sample local_iq_sample;
	struct bt_le_cs_iq_sample peer_iq_sample;
};

struct rtt_timing {
	bool failed;
	int16_t toa_tod_initiator;
	int16_t tod_toa_reflector;
};

static struct iq_sample_and_channel iq_sample_channel_data[MAX_NUM_IQ_SAMPLES];
static struct rtt_timing rtt_timing_data[MAX_NUM_RTT_SAMPLES];

struct processing_context {
	uint16_t rtt_timing_data_index;
	uint16_t iq_sample_channel_data_index;
	uint8_t n_ap;
	enum bt_conn_le_cs_role role;
};

static void calc_complex_product(int32_t z_a_real, int32_t z_a_imag, int32_t z_b_real,
				 int32_t z_b_imag, int32_t *z_out_real, int32_t *z_out_imag)
{
	*z_out_real = z_a_real * z_b_real - z_a_imag * z_b_imag;
	*z_out_imag = z_a_real * z_b_imag + z_a_imag * z_b_real;
}

static float linear_regression(float *x_values, float *y_values, uint8_t n_samples)
{
	if (n_samples == 0) {
		return 0.0;
	}

	/* Estimates b in y = a + b x */

	float y_mean = 0.0;
	float x_mean = 0.0;

	for (uint8_t i = 0; i < n_samples; i++) {
		y_mean += (y_values[i] - y_mean) / (i + 1);
		x_mean += (x_values[i] - x_mean) / (i + 1);
	}

	float b_est_upper = 0.0;
	float b_est_lower = 0.0;

	for (uint8_t i = 0; i < n_samples; i++) {
		b_est_upper += (x_values[i] - x_mean) * (y_values[i] - y_mean);
		b_est_lower += (x_values[i] - x_mean) * (x_values[i] - x_mean);
	}

	return b_est_upper / b_est_lower;
}

static void bubblesort_2(float *array1, float *array2, uint16_t len)
{
	bool swapped;
	float temp;

	for (uint16_t i = 0; i < len - 1; i++) {
		swapped = false;
		for (uint16_t j = 0; j < len - i - 1; j++) {
			if (array1[j] > array1[j + 1]) {
				temp = array1[j];
				array1[j] = array1[j + 1];
				array1[j + 1] = temp;
				temp = array2[j];
				array2[j] = array2[j + 1];
				array2[j + 1] = temp;
				swapped = true;
			}
		}

		if (!swapped) {
			break;
		}
	}
}

static float estimate_distance_using_phase_slope(struct iq_sample_and_channel *data, uint8_t len)
{
	int32_t combined_i;
	int32_t combined_q;
	uint16_t num_angles = 0;
	static float theta[MAX_NUM_IQ_SAMPLES];
	static float frequencies[MAX_NUM_IQ_SAMPLES];

	for (uint8_t i = 0; i < len; i++) {
		if (!data[i].failed) {
			calc_complex_product(data[i].local_iq_sample.i, data[i].local_iq_sample.q,
					     data[i].peer_iq_sample.i, data[i].peer_iq_sample.q,
					     &combined_i, &combined_q);

			theta[num_angles] = atan2(1.0 * combined_q, 1.0 * combined_i);
			frequencies[num_angles] = 1.0 * CS_FREQUENCY_MHZ(data[i].channel);
			num_angles++;
		}
	}

	if (num_angles < 2) {
		return 0.0;
	}

	/* Sort phases by tone frequency */
	bubblesort_2(frequencies, theta, num_angles);

	/* One-dimensional phase unwrapping */
	for (uint8_t i = 1; i < num_angles; i++) {
		float difference = theta[i] - theta[i - 1];

		if (difference > PI) {
			for (uint8_t j = i; j < num_angles; j++) {
				theta[j] -= 2.0f * PI;
			}
		} else if (difference < -PI) {
			for (uint8_t j = i; j < num_angles; j++) {
				theta[j] += 2.0f * PI;
			}
		}
	}

	float phase_slope = linear_regression(frequencies, theta, num_angles);

    float distance = -phase_slope * (SPEED_OF_LIGHT_M_PER_S / (4 * PI));
    float final_distance_m = distance / 1000000.0f; /* Scale to meters. */

    // LA STAMPA DEVE STARE PRIMA DEL RETURN!
    printk("DIST_DATA:RAW_VAL:%.2f\n", final_distance_m);

    return final_distance_m; 
}

static float estimate_distance_using_time_of_flight(uint8_t n_samples)
{
	float tof;
	float tof_mean = 0.0;

	/* Cumulative Moving Average */
	for (uint8_t i = 0; i < n_samples; i++) {
		if (!rtt_timing_data[i].failed) {
			tof = (rtt_timing_data[i].toa_tod_initiator -
			       rtt_timing_data[i].tod_toa_reflector) /
			      2;
			tof_mean += (tof - tof_mean) / (i + 1);
		}
	}

	float tof_mean_ns = tof_mean / 2.0f;

	return tof_mean_ns * SPEED_OF_LIGHT_NM_PER_S;
}

static void process_tone_info_data(struct processing_context *context,
			      struct bt_hci_le_cs_step_data_tone_info local_tone_info[],
			      struct bt_hci_le_cs_step_data_tone_info peer_tone_info[],
			      uint8_t channel, uint8_t antenna_permutation_index)
{
	for (uint8_t i = 0; i < (context->n_ap + 1); i++) {
		if (local_tone_info[i].extension_indicator != BT_HCI_LE_CS_NOT_TONE_EXT_SLOT ||
		    peer_tone_info[i].extension_indicator != BT_HCI_LE_CS_NOT_TONE_EXT_SLOT) {
			continue;
		}

		if (context->iq_sample_channel_data_index >= MAX_NUM_IQ_SAMPLES) {
			LOG_WRN("More IQ samples than size of iq_sample_channel_data array");
			return;
		}

		iq_sample_channel_data[context->iq_sample_channel_data_index].channel = channel;
		iq_sample_channel_data[context->iq_sample_channel_data_index].antenna_permutation =
			antenna_permutation_index;
		iq_sample_channel_data[context->iq_sample_channel_data_index].local_iq_sample =
			bt_le_cs_parse_pct(local_tone_info[i].phase_correction_term);
		iq_sample_channel_data[context->iq_sample_channel_data_index].peer_iq_sample =
			bt_le_cs_parse_pct(peer_tone_info[i].phase_correction_term);

		if (local_tone_info[i].quality_indicator == BT_HCI_LE_CS_TONE_QUALITY_LOW ||
		    local_tone_info[i].quality_indicator == BT_HCI_LE_CS_TONE_QUALITY_UNAVAILABLE ||
		    peer_tone_info[i].quality_indicator == BT_HCI_LE_CS_TONE_QUALITY_LOW ||
		    peer_tone_info[i].quality_indicator == BT_HCI_LE_CS_TONE_QUALITY_UNAVAILABLE) {
			iq_sample_channel_data[context->iq_sample_channel_data_index].failed = true;
		}

		context->iq_sample_channel_data_index++;
	}
}

static void process_rtt_timing_data(struct processing_context *context,
			       struct bt_hci_le_cs_step_data_mode_1 *local_rtt_data,
			       struct bt_hci_le_cs_step_data_mode_1 *peer_rtt_data)
{
	if (context->rtt_timing_data_index >= MAX_NUM_RTT_SAMPLES) {
		LOG_WRN("More RTT samples processed than size of rtt_timing_data array");
		return;
	}

	if (local_rtt_data->packet_quality_aa_check !=
		    BT_HCI_LE_CS_PACKET_QUALITY_AA_CHECK_SUCCESSFUL ||
	    local_rtt_data->packet_rssi == BT_HCI_LE_CS_PACKET_RSSI_NOT_AVAILABLE ||
	    local_rtt_data->tod_toa_reflector == BT_HCI_LE_CS_TIME_DIFFERENCE_NOT_AVAILABLE ||
	    peer_rtt_data->packet_quality_aa_check !=
		    BT_HCI_LE_CS_PACKET_QUALITY_AA_CHECK_SUCCESSFUL ||
	    peer_rtt_data->packet_rssi == BT_HCI_LE_CS_PACKET_RSSI_NOT_AVAILABLE ||
	    peer_rtt_data->tod_toa_reflector == BT_HCI_LE_CS_TIME_DIFFERENCE_NOT_AVAILABLE) {
		rtt_timing_data[context->rtt_timing_data_index].failed = true;
	}

	if (context->role == BT_CONN_LE_CS_ROLE_INITIATOR) {
		rtt_timing_data[context->rtt_timing_data_index].toa_tod_initiator =
			local_rtt_data->toa_tod_initiator;
		rtt_timing_data[context->rtt_timing_data_index].tod_toa_reflector =
			peer_rtt_data->tod_toa_reflector;
	} else if (context->role == BT_CONN_LE_CS_ROLE_REFLECTOR) {
		rtt_timing_data[context->rtt_timing_data_index].tod_toa_reflector =
			local_rtt_data->tod_toa_reflector;
		rtt_timing_data[context->rtt_timing_data_index].toa_tod_initiator =
			peer_rtt_data->toa_tod_initiator;
	}

	context->rtt_timing_data_index++;
}

static bool process_step_data(struct bt_le_cs_subevent_step *local_step,
			      struct bt_le_cs_subevent_step *peer_step, void *user_data)
{
	struct processing_context *context = (struct processing_context *)user_data;

	if (local_step->mode == BT_CONN_LE_CS_MAIN_MODE_2) {
		struct bt_hci_le_cs_step_data_mode_2 *local_step_data =
			(struct bt_hci_le_cs_step_data_mode_2 *)local_step->data;
		struct bt_hci_le_cs_step_data_mode_2 *peer_step_data =
			(struct bt_hci_le_cs_step_data_mode_2 *)peer_step->data;

		process_tone_info_data(context, local_step_data->tone_info,
				       peer_step_data->tone_info, local_step->channel,
				       local_step_data->antenna_permutation_index);

	} else if (local_step->mode == BT_HCI_OP_LE_CS_MAIN_MODE_1) {
		struct bt_hci_le_cs_step_data_mode_1 *local_step_data =
			(struct bt_hci_le_cs_step_data_mode_1 *)local_step->data;
		struct bt_hci_le_cs_step_data_mode_1 *peer_step_data =
			(struct bt_hci_le_cs_step_data_mode_1 *)peer_step->data;

		process_rtt_timing_data(context, local_step_data, peer_step_data);

	} else if (local_step->mode == BT_HCI_OP_LE_CS_MAIN_MODE_3) {
		struct bt_hci_le_cs_step_data_mode_3 *local_step_data =
			(struct bt_hci_le_cs_step_data_mode_3 *)local_step->data;
		struct bt_hci_le_cs_step_data_mode_3 *peer_step_data =
			(struct bt_hci_le_cs_step_data_mode_3 *)peer_step->data;

		process_rtt_timing_data(context,
					(struct bt_hci_le_cs_step_data_mode_1 *)local_step_data,
					(struct bt_hci_le_cs_step_data_mode_1 *)peer_step_data);

		process_tone_info_data(context, local_step_data->tone_info,
				       peer_step_data->tone_info, local_step->channel,
				       local_step_data->antenna_permutation_index);
	}

	return true;
}

void estimate_distance(struct net_buf_simple *local_steps, struct net_buf_simple *peer_steps,
		       uint8_t n_ap, enum bt_conn_le_cs_role role)
{
	struct processing_context context = {
		.rtt_timing_data_index = 0,
		.iq_sample_channel_data_index = 0,
		.n_ap = n_ap,
		.role = role,
	};

	memset(rtt_timing_data, 0, sizeof(rtt_timing_data));
	memset(iq_sample_channel_data, 0, sizeof(iq_sample_channel_data));

	bt_ras_rreq_rd_subevent_data_parse(peer_steps, local_steps, context.role, NULL,
					   process_step_data, &context);

	float phase_slope_based_distance = estimate_distance_using_phase_slope(
		iq_sample_channel_data, context.iq_sample_channel_data_index);

	float rtt_based_distance =
		estimate_distance_using_time_of_flight(context.rtt_timing_data_index);

	if (rtt_based_distance == 0.0f && phase_slope_based_distance == 0.0f) {
		LOG_INF("A reliable distance estimate could not be computed.");
	} else {
		LOG_INF("Estimated distance to reflector:");
	}

	if (rtt_based_distance != 0.0f) {
		LOG_INF("- Round-Trip Timing method: %f meters (derived from %d samples)",
			(double)rtt_based_distance, context.rtt_timing_data_index);
	}
	if (phase_slope_based_distance != 0.0f) {
		LOG_INF("- Phase-Based Ranging method: %f meters (derived from %d samples)",
			(double)phase_slope_based_distance, context.iq_sample_channel_data_index);
	}
}
```
